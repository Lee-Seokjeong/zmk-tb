## config/west.yml
```yaml
manifest:
  remotes:
    - name: zmkfirmware
      url-base: https://github.com/zmkfirmware
    - name: Lee-Seokjeong
      url-base: https://github.com/Lee-Seokjeong

  projects:
    - name: zmk-tb
      remote: Lee-Seokjeong
      revision: master
      import: app/west.yml
  self:
    path: config
  
```
